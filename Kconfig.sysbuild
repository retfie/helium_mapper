## Kconfig.sysbuild
```kconfig
#
# Copyright (c) 2023 Nordic Semiconductor ASA
#
# SPDX-License-Identifier: LicenseRef-Nordic-5-Clause
#

#### Bootloader
choice BOOTLOADER
	default BOOTLOADER_MCUBOOT if !BOARD_NRF21540DK
endchoice

source "${ZEPHYR_BASE}/share/sysbuild/Kconfig"
```

## app/sysbuild/mcuboot/boards/rak4631.conf
```kconfig
# USB CDC ACM UART
CONFIG_USB_DEVICE_STACK=y
CONFIG_USB_DEVICE_PRODUCT="MCUBOOT"

# DFU support
CONFIG_USB_DFU_CLASS=y
CONFIG_USB_DFU_ENABLE_UPLOAD=y
CONFIG_USB_DRIVER_LOG_LEVEL_ERR=y
CONFIG_USB_DEVICE_LOG_LEVEL_ERR=y
CONFIG_USB_DFU_REBOOT=y

CONFIG_IMG_MANAGER=y
CONFIG_MCUBOOT_IMG_MANAGER=y
CONFIG_STREAM_FLASH=y

CONFIG_SIZE_OPTIMIZATIONS=y
CONFIG_MULTITHREADING=y

CONFIG_BOOT_USB_DFU_WAIT=y
CONFIG_BOOT_USB_DFU_WAIT_DELAY_MS=10000

CONFIG_CONSOLE=n
CONFIG_DEBUG=n
CONFIG_RTT_CONSOLE=n
CONFIG_SERIAL=n
CONFIG_USE_SEGGER_RTT=n
CONFIG_UART_CONSOLE=n
```

## drivers/Kconfig
```kconfig
# SPDX-License-Identifier: Apache-2.0

menu "Drivers"
rsource "sensor/Kconfig"
rsource "gnss/Kconfig"
endmenu
```

## drivers/gnss/Kconfig
```kconfig
# SPDX-License-Identifier: Apache-2.0

if GNSS
rsource "Kconfig.u_blox_max7q"
endif # GNSS
```

## drivers/gnss/Kconfig.u_blox_max7q
```kconfig
# SPDX-License-Identifier: Apache-2.0

config GNSS_NMEA_U_BLOX_MAX7Q
	bool "U-Blox MAX-7Q GNSS NMEA device"
	default y
	depends on GNSS
	#          DT_HAS_<DT_DRV_COMPAT>_ENABLED
	depends on DT_HAS_U_BLOX_NMEA_MAX7Q_ENABLED
	depends on GNSS_REFERENCE_FRAME_WGS84
	select MODEM_MODULES
	select MODEM_BACKEND_UART
	select MODEM_CHAT
	select GNSS_PARSE
	select GNSS_NMEA0183
	select GNSS_NMEA0183_MATCH
	help
	  U-Blox MAX-7Q NMEA based GNSS device.

if GNSS_NMEA_U_BLOX_MAX7Q

config GNSS_NMEA_U_BLOX_MAX_7Q_SATELLITES_COUNT
	int "Maximum satellite count"
	depends on GNSS_SATELLITES
	default 24
	help
	  Maximum number of satellite that the driver that can be decoded from
	  the GNSS device. This does not affect the number of devices that the
	  device is actually tracking, just how many of those can be reported
	  in the satellites callback.

config MAX7Q_POWER_ENABLE
       bool "u-blox max-7q enable gpio"
       help
         Enable gpio for u-blox max-7q gps module

config GNSS_RUN_INIT_CHAT_SCRIPT
	bool
	help
	  Enable running of init chat script during resume

config MAX7Q_PM_TIMEOUT_MS
	int "u-blox max-7q timeout value for PM ready"
	default 0
	help
	  Max timeout value in ms for device to be ready after power on or resume

endif
```

## drivers/sensor/Kconfig
```kconfig
# SPDX-License-Identifier: Apache-2.0

if SENSOR
rsource "max7q/Kconfig"
endif # SENSOR
```

## drivers/sensor/max7q/Kconfig
```kconfig
#
# SPDX-License-Identifier: Apache-2.0

config UBLOX_MAX7Q
       bool "u-blox max-7q gps driver"
       help
         Enable driver for u-blox max-7q gps module

if UBLOX_MAX7Q

config MAX7Q_POWER_ENABLE
       bool "u-blox max-7q enable gpio"
       help
         Enable gpio for u-blox max-7q gps module

endif
```

## dts/bindings/gnss/u-blox,nmea-max7q.yaml
```yaml
#
# SPDX-License-Identifier: Apache-2.0


description: |
  u-blox MAX-7Q NMEA gps module support

  Example configuration:

  / {
        gnss_pwr: gnss-pwr-ctrl {
                compatible = "regulator-fixed";
                regulator-name = "gnss-pwr-ctrl";
                enable-gpios = <&gpio1 2 GPIO_ACTIVE_HIGH>;
        };
  };


  &uart0 {
        current-speed = <9600>;
        ...
        gnss: u_blox_max7q {
                compatible = "u-blox,nmea-max7q";
                vin-supply = <&gnss_pwr>;
        };
  };

compatible: "u-blox,nmea-max7q"

include:
  - uart-device.yaml
  - regulator.yaml
```

## dts/bindings/sensor/u-blox,max7q.yaml
```yaml
#
# SPDX-License-Identifier: Apache-2.0

description: u-blox MAX-7Q gps module support

compatible: "u-blox,max7q"

include: uart-device.yaml

properties:
  enable-gpios:
    type: phandle-array
    required: false
    description: |
      Optional gpio to enable GPS module
```

## subsys/bluetooth/services/Kconfig.nus
```kconfig
#
# Copyright (c) 2019 Nordic Semiconductor ASA
#
# SPDX-License-Identifier: LicenseRef-Nordic-5-Clause
#

config BT_NUS
	bool "Nordic UART service"
	help
	  Enable Nordic UART service.

if BT_NUS

module = BT_NUS
module-str = NUS
source "subsys/logging/Kconfig.template.log_config"

endif # BT_NUS
```

## west.yml
```yaml
# SPDX-License-Identifier: Apache-2.0

manifest:
  defaults:
    remote: upstream

  self:
    path: helium_mapper

  remotes:
    - name: upstream
      url-base: https://github.com/zephyrproject-rtos

  projects:
    - name: zephyr
      remote: upstream
      revision: v4.0.0
      import:
        name-allowlist:
          - cmsis
    - name: hal_nordic
      revision: 5c8d109371ebb740fbef1f440a3b59e488a36717
      path: modules/hal/nordic
      groups:
        - hal
    - name: loramac-node
      revision: fb00b383072518c918e2258b0916c996f2d4eebe
      path: modules/lib/loramac-node
    - name: mbedtls
      revision: a78176c6ff0733ba08018cba4447bd3f20de7978
      path: modules/crypto/mbedtls
      groups:
        - crypto
    - name: mcuboot
      revision: f74b77cf7808919837c0ed14c2ead3918c546349
      path: bootloader/mcuboot
      groups:
        - bootloader
    - name: segger
      revision: 798f95ea9304e5ed8165a661081443051f210733
      path: modules/debug/segger
      groups:
        - debug
    - name: tinycrypt
      revision: 1012a3ebee18c15ede5efc8332ee2fc37817670f
      path: modules/crypto/tinycrypt
      groups:
        - crypto
    - name: zcbor
      revision: 47f34dd7f5284e8750b5a715dee7f77c6c5bdc3f
      path: modules/lib/zcbor
```
