/*
 * Copyright (c) 2019 Vestas Wind Systems A/S
 *
 * SPDX-License-Identifier: Apache-2.0
 */

/ {
};


&boot_partition {
	reg = <0x00000000 0x00010000>;
};

&slot0_partition {
	reg = <0x00010000 0x00072000>;
};

&slot1_partition {
	reg = <0x00082000 0x00072000>;
};
